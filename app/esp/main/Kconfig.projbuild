## app/esp/main/Kconfig.projbuild
```kconfig
menu "Example Configuration"

    config ENT_WIFI_SSID
        string "ENT WiFi SSID"
        default "wpa2_test"
        help
            SSID (network name) for the example to connect to.

    config ENT_EAP_METHOD
        int "ENT EAP METHOD"
        default 1
        help
            EAP method (TLS, PEAP or TTLS) for the example to use.
            TLS: 0, PEAP: 1, TTLS: 2

    config ENT_EAP_ID
        string "ENT EAP ID"
        default "example@espressif.com"
        help
            Identity in phase 1 of EAP procedure.

    config ENT_EAP_USERNAME
        string "ENT EAP USERNAME"
        default "espressif"
        help
            Username for EAP method (PEAP and TTLS).

    config ENT_EAP_PASSWORD
        string "ENT EAP PASSWORD"
        default "test11"
        help
            Password for EAP method (PEAP and TTLS).

    config PSK_WIFI_SSID
        string "PSK WiFi SSID"
        default "myssid"
        help
            SSID (network name) for the example to connect to.

    config PSK_WIFI_PASSWORD
        string "PSK WIFI PASSWORD"
        default "mypassword"
        help
        	  Password for connecting to network

    config SECURITY_MODE
        int "NETWORK SECURITY MODE"
        default 1
        help
            Specify current network security (WPA2 Enterprise or Personal) to use.
            ENTERPRISE: 0, PERSONAL: 1

endmenu
```
